## drivers/watchdog/Kconfig.nxp
```kconfig
# Copyright 2022-2023 NXP
# SPDX-License-Identifier: Apache-2.0

config WDT_NXP_SWT
	bool "NXP Software Watchdog Timer (SWT) driver"
	default y
	depends on DT_HAS_NXP_SWT_ENABLED
	select CLOCK_CONTROL
	select NOCACHE_MEMORY if ARCH_HAS_NOCACHE_MEMORY_SUPPORT
	help
	  Enable the Software Watchdog Timer (SWT) driver.
```

## dts/bindings/mdio/snps,designware-ethernet-mdio.yaml
```yaml
# Copyright 2024 NXP
# SPDX-License-Identifier: Apache-2.0

description: Synopsys DesignWare Ethernet MDIO

compatible: "snps,designware-ethernet-mdio"

include: [mdio-controller.yaml, pinctrl-device.yaml]

properties:
  clocks:
    required: true
```
